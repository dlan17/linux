## Documentation/devicetree/bindings/gpio/spacemit,k1-gpio.yaml
```yaml
# SPDX-License-Identifier: (GPL-2.0-only OR BSD-2-Clause)
%YAML 1.2
---
$id: http://devicetree.org/schemas/gpio/spacemit,k1-gpio.yaml#
$schema: http://devicetree.org/meta-schemas/core.yaml#

title: SpacemiT K1 GPIO controller

maintainers:
  - Yixun Lan <dlan@gentoo.org>

description:
  The controller's registers are organized as sets of eight 32-bit
  registers with each set controlling a bank of up to 32 pins.  A single
  interrupt is shared for all of the banks handled by the controller.

properties:
  compatible:
    const: spacemit,k1-gpio

  reg:
    maxItems: 1

  ranges: true

  "#gpio-cells":
    const: 2

  gpio-controller: true

  gpio-ranges: true

  interrupts:
    maxItems: 1
    description:
      The interrupt shared by all GPIO lines for this controller.

  interrupt-names: true

  "#interrupt-cells":
    const: 2
    description:
      The first cell is the GPIO number, the second should specify interrupt
      flag. The controller don't support level interrupts, so the flags of
      IRQ_TYPE_LEVEL_HIGH, IRQ_TYPE_LEVEL_LOW should not be used.
      Refer <dt-bindings/interrupt-controller/irq.h> for flags.

  interrupt-controller: true

required:
  - compatible
  - reg
  - gpio-controller
  - "#gpio-cells"
  - interrupts
  - interrupt-names
  - interrupt-controller
  - "#interrupt-cells"

additionalProperties: false

examples:
  - |
    soc {
        #address-cells = <2>;
        #size-cells = <2>;

        gpio@d4019000 {
            compatible = "spacemit,k1-gpio";
            reg = <0x0 0xd4019000 0x0 0x800>;
            gpio-controller;
            #gpio-cells = <2>;
            interrupts = <58>;
            interrupt-names = "gpio_mux";
            interrupt-parent = <&plic>;
            interrupt-controller;
            #interrupt-cells = <2>;
            gpio-ranges = <&pinctrl 0 0 128>;
        };
    };
```
